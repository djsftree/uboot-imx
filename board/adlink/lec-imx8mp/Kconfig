## board/adlink/lec-imx8mp/Kconfig
```kconfig
if TARGET_LEC_IMX8MP

config SYS_BOARD
	default "lec-imx8mp"

config SYS_VENDOR
	default "adlink"

config SYS_CONFIG_NAME
	default "lec-imx8mp"

config CONFIG_IMX_DDRSIZE
	bool "Define lec-imx8mp DDR Size"
	depends on TARGET_LEC_IMX8MP

choice
	prompt "Select a lec-imx8mp DDR Size"
	depends on CONFIG_IMX_DDRSIZE

	config LPDDR4_2GB
		bool "LPDDR4_2GB"

        config LPDDR4_2GK
		bool "LPDDR4_2GK"

	config LPDDR4_4GB
		bool "LPDDR4_4GB"

	config LPDDR4_8GB
		bool "LPDDR4_8GB"

endchoice

source "board/adlink/common/Kconfig"

endif
```

## board/adlink/mxa-200/Kconfig
```kconfig
if TARGET_IMX8MP_MXA200

config SYS_BOARD
	default "mxa-200"

config SYS_VENDOR
	default "adlink"

config SYS_CONFIG_NAME
	default "mxa-200"

config IMX_CONFIG
	default "board/adlink/mxa-200/imximage-8mp-lpddr4.cfg"

source "board/freescale/common/Kconfig"

endif
```

## board/ftree/imx8mp_ft20/Kconfig
```kconfig
if TARGET_IMX8MP_FT20

config SYS_BOARD
	default "imx8mp_ft20"

config SYS_VENDOR
	default "ftree"

config SYS_CONFIG_NAME
	default "imx8mp_ft20"

config IMX_CONFIG
	default "board/ftree/imx8mp_ft20/imximage-8mp-lpddr4.cfg"

endif
```
